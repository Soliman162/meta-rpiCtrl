## conf/distro/rpictrl-distro.conf
```bitbake
MAINTAINER = "Soliman <ahmedsliman215@gmail.com>"

require conf/distro/poky.conf

DISTRO = "rpictrl-distro"
DISTRO_NAME = "rpictrl distro"
DISTRO_VERSION = "1.0"

# set hostname
hostname_pn-base-files = "Control@RPI"

DISTRO_FEATURES:append = " systemd wifi"
VIRTUAL-RUNTIME:init_manager = "systemd"           

# set default time zone
DEFAULT_TIMEZONE = "Africa/Cairo"
```

## conf/distro/stopwatch-distro.conf
```bitbake
MAINTAINER = "Soliman <ahmedsliman215@gmail.com>"

require conf/distro/poky.conf

DISTRO = "stopwatch-distro"
DISTRO_NAME = "Stop Watch distro"
DISTRO_VERSION = "1.0"

# set hostname
hostname_pn-base-files = "Watch@RPI"

DISTRO_FEATURES:append = " systemd wifi"
VIRTUAL-RUNTIME:init_manager = "systemd"           

# set default time zone
DEFAULT_TIMEZONE = "Africa/Cairo"
```

## conf/layer.conf
```bitbake
# We have a conf and classes directory, add to BBPATH
BBPATH .= ":${LAYERDIR}"

# We have recipes-* directories, add to BBFILES
BBFILES += "${LAYERDIR}/recipes-*/*/*.bb \
            ${LAYERDIR}/recipes-*/*/*.bbappend"

BBFILE_COLLECTIONS += "meta-rpictrl"
BBFILE_PATTERN_meta-rpictrl = "^${LAYERDIR}/"
BBFILE_PRIORITY_meta-rpictrl = "6"

LAYERDEPENDS_meta-rpictrl = "core"
LAYERSERIES_COMPAT_meta-rpictrl = "dunfell"
```

## conf/machine/raspberrypi3-64-machine.conf
```bitbake
#@TYPE: RaspberryPi 3 b pluse custom Machine
#@NAME: RaspberryPi 3 Development Board
#@DESCRIPTION: Machine configuration for the RaspberryPi 3 in 64 bits mode

MACHINEOVERRIDES =. "raspberrypi3-64:"


MACHINE_EXTRA_RRECOMMENDS += "\
    linux-firmware-rpidistro-bcm43430 \
    linux-firmware-rpidistro-bcm43455 \
    bluez-firmware-rpidistro-bcm43430a1-hcd \
    bluez-firmware-rpidistro-bcm4345c0-hcd \
"

require conf/machine/include/tune-cortexa53.inc
include conf/machine/include/rpi-base.inc

RPI_KERNEL_DEVICETREE = " \
    broadcom/bcm2710-rpi-3-b.dtb \
    broadcom/bcm2710-rpi-3-b-plus.dtb \
    broadcom/bcm2837-rpi-3-b.dtb \
    "

UBOOT_ELF = "u-boot"
UBOOT_MACHINE = "rpi_3_b_plus_defconfig"
EXTRA_IMAGEDEPENDS += "u-boot"

MACHINE_ESSENTIAL_EXTRA_RRECOMMENDS += " kernel-modules"

#
# When u-boot is enabled we need to use the "Image" format and the "booti"
# command to load the kernel
KERNEL_IMAGETYPE_UBOOT ?= "Image"
# "zImage" not supported on arm64 and ".gz" images not supported by bootloader yet
KERNEL_IMAGETYPE_DIRECT ?= "Image"
KERNEL_BOOTCMD ?= "booti"

VC4DTBO ?= "vc4-fkms-v3d"
ARMSTUB ?= "armstub8.bin"

# Enable Uart
ENABLE_UART = "1"

# set uart buadrate and port
SERIAL_CONSOLE = "115200 ttyS0"
```
